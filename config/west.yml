## config/west.yml
```yaml
manifest:
  remotes:
    - name: zmkfirmware
      url-base: https://github.com/zmkfirmware
    - name: lowprokb
      url-base: https://github.com/lowprokb
  projects:
    - name: zmk
      remote: zmkfirmware
      revision: main
      import: app/west.yml
    - name: zmk-config-corne-ish-zen
      remote: lowprokb
      revision: main
  self:
    path: config
```
